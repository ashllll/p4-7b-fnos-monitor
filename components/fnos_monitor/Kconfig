## components/fnos_monitor/Kconfig
```kconfig
menu "fnOS monitor"

    config FNOS_POLL_INTERVAL_MS
        int "Telemetry request period (ms; runtime override: poll <ms>)"
        range 50 60000
        default 200
        help
            Includes request and parse time. Slow cycles yield without sending
            catch-up bursts. Volatile runtime overrides reset after reboot.

    config FNOS_UI_REFRESH_MS
        int "Minimum UI data frame period (ms)"
        range 50 1000
        default 100
        help
            UI data frames never run faster than this period and never run
            faster than telemetry. Navigation keeps its own display cadence.

    config FNOS_HEAP_DEBUG
        bool "打印堆余量与任务状态（每 10 秒）"
        default n
        help
            打开后每 10 秒在串口打印内部 RAM / DMA / PSRAM 余量、LVGL 任务状态、
            轮询统计。排查"界面冻结""内存下滑"时打开它比猜快得多。

    config FNOS_SOAK_DIAG
        bool "72 小时长测诊断心跳（每 10 秒一行 FNOS_DIAG JSON）"
        default n
        help
            打开后由 **LVGL 事件循环**每 10 秒往串口打一行机器可读诊断：堆历史最小值与
            最大连续块（内部/DMA/PSRAM）、LVGL 与 fnos_poll/fnos_pair 三个任务的栈余量、
            距上次刷新的秒数、轮询成功/失败计数与 P95 耗时、最近成功帧的 NAS 采集时间、
            复位原因、固件 ELF 的 SHA-256。tools/audit125/soak72.py 只读采集这一行做
            72 小时验收。心跳本身有观察开销（每 10 秒几十微秒），生产版保持关闭；
            关掉后编译产物与打开前完全一致。它只证明 LVGL 任务还活着、间隔 ≤15 秒，
            **不代表帧耗时或触摸延迟**。

    config FNOS_AUTO_PAGE_SEC
        int "自动轮播页面间隔（秒，0=关闭）"
        range 0 120
        default 0
        help
            只用于视觉验收：打开后每 N 秒自动切到下一页，方便用摄像头逐页拍照核对。
            平时保持 0，交给你自己点导航/滑动翻页。

    config FNOS_PALETTE
        string "主题（michka / cuktech / unifi / cuktech-console / device / graphite / abyss / phosphor）"
        default "michka"
        help
            预置配色见 components/fnos_monitor/ui_kit/uk_theme.c：
              michka           当前默认：michka 远程显示方向（见 docs/ui-michka-slate-2026-10-22.md）
              cuktech          暖黑仪表、象牙白与香槟金（历史备选）
              unifi            中性深灰控制台、白色强调与分隔线清单
              cuktech-console  ULTRA 参考：黑底白字，冰青/蓝强调、局部橙色（历史默认）
              device           暖黑与铜色
              graphite         暖中性石墨
              abyss            深黑与暖金
              phosphor         橄榄暖黑
            主题集中控制配色、圆角和清单视觉；页面由 ui_kit/ 原生 LVGL flex 排版。
            占用率阈值由 FNOS_UI_USAGE_WARM/HIGH 控制，颜色来自当前主题。
            cuktech-console 低占用为冰青，提醒为蓝色，接近上限为朱红。
            状态色用于圆弧与进度条，历史曲线保持指标身份色；避免紫色。
            名字写错会退回 michka（设备照样能开机）。

    config FNOS_STATUS_MAX_BYTES
        int "Maximum telemetry response bytes"
        range 16384 1048576
        default 262144
        help
            Receive buffers grow in PSRAM according to the actual frame. This
            is a transport resource budget, not a device-count or name limit.
            Oversized frames preserve the previous snapshot and report a fault.

    config FNOS_SNAPSHOT_MAX_BYTES
        int "Maximum inventory storage bytes per snapshot"
        range 65536 4194304
        default 1048576
        help
            Full device names and inventory records allocate on demand in PSRAM.
            Exhausting the budget rejects the frame rather than omitting devices.

    config FNOS_CHART_WINDOW
        int "曲线窗口（秒，1 Hz 采样点数）"
        range 60 600
        default 180
        help
            网络/CPU 曲线在屏幕上保留的秒数。点数越多内存与重绘开销越大。

    menu "UI reference ranges and layout"

        config FNOS_UI_TREND_SMOOTH_SAMPLES
            int "Trailing samples averaged in displayed trend lines (1 disables)"
            range 1 127
            default 3
            help
                Smooth short-period fluctuations only in the displayed line.
                Current readings, historical peaks and sample counts keep the
                original data. A missing sample breaks and resets the window.

        config FNOS_UI_FLOW_SMOOTH_SAMPLES
            int "Samples per smoothing pass in flow curves (1 disables)"
            range 1 127
            default 9
            help
                All product history curves use two moving-average passes,
                evaluated as a triangular kernel of 2*N-1 trailing samples.
                Larger windows suppress short ripples but delay the displayed
                trend by roughly N-1 samples. The kernel fits the chart ring.
                Live readings and raw peaks remain immediate. Missing samples
                reset the averaging window.

        config FNOS_UI_TREND_SCROLL_MS
            int "Maximum sample interval animated as continuous chart travel (ms)"
            range 0 5000
            default 2000
            help
                Advance the native time axis at constant speed between samples.
                Longer gaps snap to the newest window. Zero disables streaming.

        config FNOS_UI_TREND_FPS
            int "Maximum local streaming chart frame rate"
            range 1 60
            default 60
            help
                Limits local drawing only; never changes NAS collection or polling.

        config FNOS_UI_TEXT_SCRATCH_BYTES
            int "UI formatting scratch buffer on the LVGL stack (bytes)"
            range 64 1024
            default 256
            help
                Format ordinary labels once without allocating a temporary string.
                Longer text uses an exact-size allocation and is never truncated.

        config FNOS_UI_REDUCED_MOTION
            bool "Use gentler page transitions"
            default n
            help
                Show numeric updates immediately. Keep finger tracking and navigation, but settle directly on
                release. Content and selection feedback remain visible.

        config FNOS_UI_NUMBER_BUDGET_BYTES
            int "Transient numeric glyph layer budget (bytes)"
            range 1024 524288
            default 131072
            help
                Optional animation falls back to the latest static reading on
                budget exhaustion. This never limits telemetry or inventory.

        config FNOS_UI_NUMBER_MS
            int "Damped telemetry response duration (ms; 0 disables motion)"
            range 0 1000
            default 600
            help
                Damped digits, gauges and bars share this response
                duration; meters retain a subpixel tail for at most twice it.
                New targets preserve current position and velocity.
                Zero disables motion; sampling and history remain unchanged.

        config FNOS_UI_TELEMETRY_DAMPING
            int "Telemetry natural frequency factor"
            range 6 12
            default 8
            help
                Natural frequency = factor / response duration in seconds.
                Used by the vendored Ryan Juckett Damped Springs solver.

        config FNOS_UI_TELEMETRY_RATIO_PERMILLE
            int "Telemetry damping ratio (1000 = critical)"
            range 800 1200
            default 1000
            help
                850 gives a restrained ammeter rebound (about 0.6 percent
                overshoot from rest). 1000 removes that rebound. Gauge output
                remains bounded by its legal range; source data is unchanged.

        config FNOS_UI_NUMBER_PRESENT_MS
            int "Minimum interval between presented numeric changes (ms)"
            range 0 5000
            default 600
            help
                Select the newest numeric reading on one shared presentation
                beat so rapid telemetry does not continually interrupt digits.
                Sampling, history and alerts remain independent. Zero opts out.

        config FNOS_UI_NUMBER_STAGGER_MS
            int "Numeric changed-position stagger (ms)"
            range 0 100
            default 0

        config FNOS_UI_NUMBER_MAX_STAGGER_MS
            int "Maximum total numeric stagger (ms)"
            range 0 200
            default 0

        config FNOS_UI_NUMBER_TRAVEL_PCT
            int "Numeric travel (% of font line height)"
            range 0 50
            default 4

        config FNOS_UI_NUMBER_BLUR_PCT
            int "Numeric sampled blur (% of font line height; 0 disables)"
            range 0 10
            default 0

        config FNOS_UI_MOTION_STATS
            bool "Log page preparation and render timing"
            default n
            help
                Print aggregate timing for page transitions, without telemetry
                or endpoint details. Enable locally when profiling the display.

        config FNOS_UI_PERF_BENCH
            bool "Touch/render benchmark console (bench command)"
            default n
            help
                Add the serial `bench` command: while a run is active it
                substitutes a scripted pointer sequence for the panel reading,
                then prints press-to-frame latency, drag frame intervals,
                refresh cost and per-task CPU. Nothing is compiled or called
                when this is off, and the real touch callback is restored as
                soon as a run ends. Bench devices only.

        config FNOS_UI_PERF_DRAW
            bool "High-frequency software draw probes"
            depends on FNOS_UI_PERF_BENCH
            default n
            help
                Instrument task creation, selection, blending and text drawing.
                Timer reads on thousands of calls per frame add measurable cost.
                Enable only for attribution; leave off for performance comparisons.

        config FNOS_UI_USAGE_WARM
            int "Usage attention reference (%)"
            range 1 99
            default 80

        config FNOS_UI_USAGE_HIGH
            int "Usage high reference (%)"
            range FNOS_UI_USAGE_WARM 100
            default 90

        config FNOS_UI_TEMP_WARM
            int "Temperature attention reference (C)"
            range 1 199
            default 75
            help
                Visual reference only. Sensor limits vary by hardware; actual
                health alerts come from the collector, shown on the System page.

        config FNOS_UI_TEMP_HIGH
            int "Temperature high reference (C)"
            range FNOS_UI_TEMP_WARM 200
            default 80

        config FNOS_UI_LIST_MIN_WIDTH
            int "Preferred list content width (pixels)"
            range 160 640
            default 260
            help
                The outer system cards wrap according to the available width.
                Temperature device columns use the same content-width target.

    endmenu

endmenu
```
